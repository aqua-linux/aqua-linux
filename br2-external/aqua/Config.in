## br2-external/aqua/Config.in
```kconfig
menu "Aqua Linux"

config BR2_PACKAGE_AQUA_BOOT_MARKERS
    bool "Aqua boot markers"
    default y
    help
      Installs the early recovery boot marker scripts used by Milestone 1.

source "$BR2_EXTERNAL_AQUA_PATH/package/aqua-audio-native/Config.in"
source "$BR2_EXTERNAL_AQUA_PATH/package/aqua-audio-probe/Config.in"

endmenu
```

## br2-external/aqua/configs/aqua_x86_64_audio_rehearsal_defconfig
```kconfig
# This profile is for dependency and legal-info rehearsal only. The default
# Aqua image remains aqua_x86_64_defconfig with audio packages disabled.
BR2_x86_64=y
BR2_JLEVEL=1
BR2_TOOLCHAIN_BUILDROOT_MUSL=y
BR2_TOOLCHAIN_BUILDROOT_CXX=y
BR2_INIT_BUSYBOX=y
BR2_ROOTFS_DEVICE_CREATION_DYNAMIC_EUDEV=y
BR2_TARGET_GENERIC_HOSTNAME="aqua-linux"
BR2_TARGET_GENERIC_ISSUE="Aqua Linux audio dependency rehearsal"
BR2_TARGET_GENERIC_ROOT_PASSWD=""
BR2_SYSTEM_DHCP="eth0"
BR2_PACKAGE_LIBXKBCOMMON=y
BR2_PACKAGE_LIBINPUT=y
BR2_PACKAGE_XKEYBOARD_CONFIG=y
BR2_PACKAGE_BUSYBOX_SHOW_OTHERS=y
BR2_PACKAGE_UTIL_LINUX_BINARIES=y
BR2_PACKAGE_E2FSPROGS=y
BR2_PACKAGE_DOSFSTOOLS=y
BR2_PACKAGE_DOSFSTOOLS_MKFS_FAT=y
BR2_PACKAGE_TAR=y
BR2_PACKAGE_WESTON=y
BR2_PACKAGE_WESTON_DEFAULT_HEADLESS=y
BR2_PACKAGE_WESTON_HEADLESS=y
BR2_PACKAGE_WESTON_SIMPLE_CLIENTS=y
BR2_PACKAGE_WESTON_SHELL_DESKTOP=y
BR2_PACKAGE_WESTON_SHELL_FULLSCREEN=n
BR2_PACKAGE_WESTON_SHELL_IVI=n
BR2_PACKAGE_WESTON_SHELL_KIOSK=n
BR2_PACKAGE_WESTON_SCREENSHARE=n
BR2_PACKAGE_MESA3D=y
BR2_PACKAGE_MESA3D_GALLIUM_DRIVER_SWRAST=y
BR2_PACKAGE_MESA3D_GALLIUM_DRIVER_VIRGL=y
BR2_PACKAGE_MESA3D_GBM=y
BR2_PACKAGE_MESA3D_OPENGL_EGL=y
BR2_PACKAGE_MESA3D_OPENGL_ES=y

# R4 audio dependency closure. Optional compatibility and remote-device stacks
# stay unselected until their own product and evidence gates exist.
BR2_PACKAGE_ALSA_LIB=y
BR2_PACKAGE_ALSA_LIB_PCM_PLUGINS="hw plug rate route softvol null ioplug"
BR2_PACKAGE_ALSA_LIB_CTL_PLUGINS="hw ext"
BR2_PACKAGE_ALSA_LIB_ALOAD=n
BR2_PACKAGE_ALSA_LIB_HWDEP=n
BR2_PACKAGE_ALSA_LIB_ALISP=n
BR2_PACKAGE_ALSA_LIB_OLD_SYMBOLS=n
BR2_PACKAGE_ALSA_LIB_TOPOLOGY=n
BR2_PACKAGE_PIPEWIRE=y
BR2_PACKAGE_PIPEWIRE_COMPRESS_OFFLOAD=n
BR2_PACKAGE_PIPEWIRE_EXAMPLES=n
BR2_PACKAGE_PIPEWIRE_GSTREAMER=n
BR2_PACKAGE_PIPEWIRE_V4L2=n
BR2_PACKAGE_LUA=y
BR2_PACKAGE_LUA_5_4=y
BR2_PACKAGE_WIREPLUMBER=y
BR2_PACKAGE_AQUA_AUDIO_NATIVE=y
BR2_PACKAGE_DBUS=n
BR2_PACKAGE_BLUEZ5_UTILS=n
BR2_PACKAGE_JACK2=n
BR2_PACKAGE_PULSEAUDIO=n
BR2_PACKAGE_FFMPEG=n
BR2_PACKAGE_AVAHI=n
BR2_PACKAGE_LIBCAMERA=n

BR2_ROOTFS_OVERLAY="$(BR2_EXTERNAL_AQUA_PATH)/rootfs-overlay"
BR2_ROOTFS_USERS_TABLES="$(BR2_EXTERNAL_AQUA_PATH)/users.txt"
BR2_ROOTFS_POST_BUILD_SCRIPT="$(BR2_EXTERNAL_AQUA_PATH)/board/aqua/x86_64/post-build.sh"
BR2_ROOTFS_POST_IMAGE_SCRIPT="$(BR2_EXTERNAL_AQUA_PATH)/board/aqua/x86_64/post-image.sh"
BR2_LINUX_KERNEL=y
BR2_LINUX_KERNEL_CUSTOM_VERSION=y
BR2_LINUX_KERNEL_CUSTOM_VERSION_VALUE="6.6.32"
BR2_PACKAGE_HOST_LINUX_HEADERS_CUSTOM_6_6=y
BR2_LINUX_KERNEL_USE_CUSTOM_CONFIG=y
BR2_LINUX_KERNEL_CUSTOM_CONFIG_FILE="$(BR2_EXTERNAL_AQUA_PATH)/board/aqua/x86_64/linux.config"
BR2_TARGET_GRUB2=y
BR2_TARGET_GRUB2_X86_64_EFI=y
BR2_TARGET_GRUB2_BUILTIN_MODULES_EFI="boot linux ext2 fat part_gpt normal efi_gop search search_label"
BR2_TARGET_ROOTFS_EXT2=y
BR2_TARGET_ROOTFS_EXT2_4=y
BR2_TARGET_ROOTFS_EXT2_SIZE="256M"
```

## br2-external/aqua/configs/aqua_x86_64_defconfig
```kconfig
BR2_x86_64=y
BR2_JLEVEL=1
BR2_TOOLCHAIN_BUILDROOT_MUSL=y
BR2_TOOLCHAIN_BUILDROOT_CXX=y
BR2_INIT_BUSYBOX=y
BR2_ROOTFS_DEVICE_CREATION_DYNAMIC_EUDEV=y
BR2_TARGET_GENERIC_HOSTNAME="aqua-linux"
BR2_TARGET_GENERIC_ISSUE="Aqua Linux Milestone 1 recovery"
BR2_TARGET_GENERIC_ROOT_PASSWD=""
BR2_SYSTEM_DHCP="eth0"
BR2_PACKAGE_LIBXKBCOMMON=y
BR2_PACKAGE_LIBINPUT=y
BR2_PACKAGE_XKEYBOARD_CONFIG=y
BR2_PACKAGE_BUSYBOX_SHOW_OTHERS=y
BR2_PACKAGE_UTIL_LINUX_BINARIES=y
BR2_PACKAGE_E2FSPROGS=y
BR2_PACKAGE_DOSFSTOOLS=y
BR2_PACKAGE_DOSFSTOOLS_MKFS_FAT=y
BR2_PACKAGE_TAR=y
BR2_PACKAGE_WESTON=y
BR2_PACKAGE_WESTON_DEFAULT_HEADLESS=y
BR2_PACKAGE_WESTON_HEADLESS=y
BR2_PACKAGE_WESTON_SIMPLE_CLIENTS=y
BR2_PACKAGE_WESTON_SHELL_DESKTOP=y
BR2_PACKAGE_WESTON_SHELL_FULLSCREEN=n
BR2_PACKAGE_WESTON_SHELL_IVI=n
BR2_PACKAGE_WESTON_SHELL_KIOSK=n
BR2_PACKAGE_WESTON_SCREENSHARE=n
BR2_PACKAGE_MESA3D=y
BR2_PACKAGE_MESA3D_GALLIUM_DRIVER_SWRAST=y
BR2_PACKAGE_MESA3D_GALLIUM_DRIVER_VIRGL=y
BR2_PACKAGE_MESA3D_GBM=y
BR2_PACKAGE_MESA3D_OPENGL_EGL=y
BR2_PACKAGE_MESA3D_OPENGL_ES=y
BR2_ROOTFS_OVERLAY="$(BR2_EXTERNAL_AQUA_PATH)/rootfs-overlay"
BR2_ROOTFS_POST_BUILD_SCRIPT="$(BR2_EXTERNAL_AQUA_PATH)/board/aqua/x86_64/post-build.sh"
BR2_ROOTFS_POST_IMAGE_SCRIPT="$(BR2_EXTERNAL_AQUA_PATH)/board/aqua/x86_64/post-image.sh"
BR2_LINUX_KERNEL=y
BR2_LINUX_KERNEL_CUSTOM_VERSION=y
BR2_LINUX_KERNEL_CUSTOM_VERSION_VALUE="6.6.32"
BR2_LINUX_KERNEL_USE_CUSTOM_CONFIG=y
BR2_LINUX_KERNEL_CUSTOM_CONFIG_FILE="$(BR2_EXTERNAL_AQUA_PATH)/board/aqua/x86_64/linux.config"
BR2_TARGET_GRUB2=y
BR2_TARGET_GRUB2_X86_64_EFI=y
BR2_TARGET_GRUB2_BUILTIN_MODULES_EFI="boot linux ext2 fat part_gpt normal efi_gop search search_label"
BR2_TARGET_ROOTFS_EXT2=y
BR2_TARGET_ROOTFS_EXT2_4=y
BR2_TARGET_ROOTFS_EXT2_SIZE="256M"
# QEMU's direct kernel loader remains the deterministic development path. The
# installer consumes GRUB's generated efi-part/EFI/BOOT/bootx64.efi artifact.
```

## br2-external/aqua/package/aqua-audio-native/Config.in
```kconfig
config BR2_PACKAGE_AQUA_AUDIO_NATIVE
    bool "Aqua WirePlumber native audio binding"
    depends on BR2_PACKAGE_WIREPLUMBER
    help
      Installs Aqua's bounded native WirePlumber 0.5 API bridge. This
      package is opt-in and does not start PipeWire or WirePlumber.
```

## br2-external/aqua/package/aqua-audio-probe/Config.in
```kconfig
config BR2_PACKAGE_AQUA_AUDIO_PROBE
    bool "Aqua ALSA media-path probe"
    depends on BR2_PACKAGE_ALSA_LIB
    depends on BR2_PACKAGE_AQUA_AUDIO_NATIVE
    help
      Installs Aqua's bounded playback and capture probe for declared-device
      QEMU acceptance, including control acknowledgement through the
      authoritative WirePlumber API bridge. This test-only binary does not
      manage audio policy.
```

## br2-external/aqua/package/aqua-glfw-wayland-probe/Config.in
```kconfig
config BR2_PACKAGE_AQUA_GLFW_WAYLAND_PROBE
	bool "Aqua GLFW Wayland compatibility probe"
	depends on BR2_PACKAGE_WAYLAND
	select BR2_PACKAGE_LIBGLFW
	help
	  Installs a bounded test-only GLFW 3.4 client that uses GLFW's native
	  Wayland window and input lifecycle while presenting an ARGB8888 wl_shm
	  buffer. It does not require X11 or client-side dma-buf support.
```

## br2-external/aqua/package/aqua-wifi-native/Config.in
```kconfig
config BR2_PACKAGE_AQUA_WIFI_NATIVE
    bool "Aqua wpa_supplicant native control binding"
    depends on BR2_PACKAGE_WPA_SUPPLICANT
    depends on BR2_PACKAGE_WPA_SUPPLICANT_WPA_CLIENT_SO
    select BR2_PACKAGE_LIBOPENSSL
    help
      Installs Aqua's bounded native wpa_supplicant control and WPA2 PSK
      derivation bridge. This opt-in package does not start a service.
```
